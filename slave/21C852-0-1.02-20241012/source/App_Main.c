/*
=================================================================================

 文件名:    App_Main.c
                   
 功能描述:  系统主程序。

 编写者:     伍泽东
 编写日期:  2011-3-31 
       
=================================================================================
*/

/*--------------------------------------------------------------------------------*/
#include "F28335_Device.h"     /* F28335 外设头文件*/
#include "App_UserDef.h"      /* F28335 应用项目头文件*/
#include "App_Main.h"     	  /* PMSM主程序头文件*/
/*--------------------------------------------------------------------------------*/

/*
-------------------------------------------------------------------------------
 主程序入口-->复位上电,建立C环境后程序即进入main()
-------------------------------------------------------------------------------
*/

void main(void)
{
	volatile Uint16  i=0,j=0;
    /* 关闭总中断,清除所有CPU中断标志,及关闭CPU级中断*/
	DINT;
	IER = 0x0000;
	IFR = 0x0000;

    /*初始化系统控制，PLL,WatchDog，使能外设时钟*/
    InitSysCtrl();
	if(RUN_MODE == RUN_FLASH)
	{
		MemCopy(&RamfuncsLoadStart0, &RamfuncsLoadEnd0, &RamfuncsRunStart0);	
   		MemCopy(&RamfuncsLoadStart1, &RamfuncsLoadEnd1, &RamfuncsRunStart1);
	}

    /* 初始化各外设*/
	InitPeripherals();
	IGBT_PCTRL_L;
	EN_WORK_H;
	OPEN_INT1_L;

	if(BORAD_NUM == 0 || BORAD_NUM == 2 || BORAD_NUM == 4)
		ET_IO_OUT2_L;
	
	if(BORAD_NUM == 2)
		ET_IO_OUT1_L;
	if(BORAD_NUM == 3)
		ET_IO_OUT2_L;

	/*延时1s*/
	for(i=0;i<2000;i++)
	{
		DELAY_US(1000);
	}
    /* 初始化PIE控制寄存器(所有的PIE中断关闭中断标志清除)*/
	InitPieCtrl();

    /* 初始化PIE中断向量表 指向默认的中断服务程序(用于调试)*/
	InitPieVectTable();

    /*主循环程序*/
    MainLoop();

}


/*
===============================================================================
 No more.
===============================================================================
*/

